// SPDX-License-Identifier: GPL-2.0-or-later OR MIT

#include "mt7620a_zbtlink_zbt-we1026-h.dtsi"

/ {
	compatible = "zbtlink,zbt-we1026-h-16m", "zbtlink,zbt-we1026-h",
		"zbtlink,zbt-we1026", "ralink,mt7620a-soc";
	model = "Zbtlink ZBT-WE1026-H (16M)";
};

&firmware {
	reg = <0x50000 0xfb0000>;
};
